## esp32/main/Kconfig.projbuild
```kconfig
menu "Experiment Configuration"

    config WIFI_SSID
        string "WiFi SSID"
        default "Aniket OP6"
        help
            SSID (network name) for the example to connect to.

    config WIFI_PASSWORD
        string "WiFi Password"
        default "12345678"
        help
            WiFi password (WPA or WPA2) for the example to use.

    config BROKER_URL
        string "Broker URL"
        default "mqtt://192.168.43.19:1883"
        help
            URL of the broker to connect to

    config BROKER_URL_FROM_STDIN
        bool
        default y if BROKER_URL = "FROM_STDIN"

endmenu
```
